## boards/shields/corney_island/Kconfig.defconfig
```kconfig
if SHIELD_CORNEY_ISLAND_LEFT

config ZMK_KEYBOARD_NAME
    default "Corney Island"

config ZMK_SPLIT_ROLE_CENTRAL
    default y

endif

if SHIELD_CORNEY_ISLAND_LEFT || SHIELD_CORNEY_ISLAND_RIGHT

config ZMK_SPLIT
    default y

endif
```

## boards/shields/corney_island/Kconfig.shield
```kconfig
config SHIELD_CORNEY_ISLAND_LEFT
    def_bool $(shields_list_contains,corney_island_left)

config SHIELD_CORNEY_ISLAND_RIGHT
    def_bool $(shields_list_contains,corney_island_right)
```
